## config/west.yml
```yaml
manifest:
  defaults:
    revision: main
  remotes:
    - name: zmkfirmware
      url-base: https://github.com/zmkfirmware
    - name: efogdev
      url-base: https://github.com/efogdev
    - name: badjeff
      url-base: https://github.com/badjeff
    - name: machetie
      url-base: https://github.com/machetie
  projects:
    - name: zmk
      remote: zmkfirmware
      import: app/west.yml
    - name: zmk-pmw3610-driver
      remote: efogdev
      revision: zephyr-4.1
    - name: zmk-report-rate-limit
      remote: efogdev
      revision: main
    - name: zmk-input-processor-xyz
      remote: badjeff
      revision: main
    - name: zmk-dongle-screen
      remote: machetie
      revision: main
  self:
    path: config
```
