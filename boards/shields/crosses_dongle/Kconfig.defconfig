## boards/shields/crosses_dongle/Kconfig.defconfig
```kconfig
if SHIELD_CROSSES_DONGLE
config ZMK_SPLIT
    default y
config ZMK_POINTING
    default y
config ZMK_SPLIT_ROLE_CENTRAL
    default y
config ZMK_SPLIT_BLE_CENTRAL_PERIPHERALS
    default 2
config ZMK_KEYBOARD_NAME
    default "Crosses"
endif
```

## config/boards/shields/crosses_right_peripheral/Kconfig.defconfig
```kconfig
if SHIELD_CROSSES_RIGHT_PERIPHERAL

config ZMK_KEYBOARD_NAME
    default "Crosses"

config ZMK_SPLIT_ROLE_CENTRAL
    default n

endif
```

## config/boards/shields/xiao_dongle/Kconfig.defconfig
```kconfig
if SHIELD_XIAO_DONGLE

config ZMK_KEYBOARD_NAME
    default "Crosses"

config ZMK_SPLIT_ROLE_CENTRAL
    default y

endif
```
